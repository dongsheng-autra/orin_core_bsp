// SPDX-License-Identifier: GPL-2.0-only


/dts-v1/;
/plugin/;

/ {
	overlay-name = "Sensing Camera Module";
	jetson-header-name = "Jetson AGX CSI Connector";
	compatible = "nvidia,p3737-0000+p3701-0000", "nvidia,p3737-0000+p3701-0004", "nvidia,p3737-0000+p3701-0005";

	/* Enable VI ports */
	fragment@0 {
		target-path = "/tegra-capture-vi";
		__overlay__ {
			num-channels = <16>;
		};
	};
	fragment@1 {
		target-path = "/tegra-capture-vi/ports/port@0";
		__overlay__ {
			status = "okay";
		};
	};
	fragment@2 {
		target-path = "/tegra-capture-vi/ports/port@0/endpoint";
		__overlay__ {
			status = "okay";
			vc-id = <0>;
			port-index = <0>;
			bus-width = <4>;
		};
	};
	fragment@3 {
		target-path = "/tegra-capture-vi/ports/port@1";
		__overlay__ {
			status = "okay";
		};
	};
	fragment@4 {
		target-path = "/tegra-capture-vi/ports/port@1/endpoint";
		__overlay__ {
			status = "okay";
			vc-id = <1>;
			port-index = <0>;
			bus-width = <4>;
		};
	};
	fragment@5 {
		target-path = "/tegra-capture-vi/ports/port@2";
		__overlay__ {
			status = "okay";
		};
	};
	fragment@6 {
		target-path = "/tegra-capture-vi/ports/port@2/endpoint";
		__overlay__ {
			status = "okay";
			vc-id = <2>;
			port-index = <0>;
			bus-width = <4>;
		};
	};
	fragment@7 {
		target-path = "/tegra-capture-vi/ports/port@3";
		__overlay__ {
			status = "okay";
		};
	};
	fragment@8 {
		target-path = "/tegra-capture-vi/ports/port@3/endpoint";
		__overlay__ {
			status = "okay";
			vc-id = <3>;
			port-index = <0>;
			bus-width = <4>;
		};
	};
	fragment@9 {
		target-path = "/tegra-capture-vi/ports/port@4";
		__overlay__ {
			status = "okay";
		};
	};
	fragment@10 {
		target-path = "/tegra-capture-vi/ports/port@4/endpoint";
		__overlay__ {
			status = "okay";
			vc-id = <0>;
			port-index = <2>;
			bus-width = <4>;
		};
	};
	fragment@11 {
		target-path = "/tegra-capture-vi/ports/port@5";
		__overlay__ {
			status = "okay";
		};
	};
	fragment@12 {
		target-path = "/tegra-capture-vi/ports/port@5/endpoint";
		__overlay__ {
			status = "okay";
			vc-id = <1>;
			port-index = <2>;
			bus-width = <4>;
		};
	};
	fragment@13 {
		target-path = "/tegra-capture-vi/ports/port@6";
		__overlay__ {
			status = "okay";
		};
	};
	fragment@14 {
		target-path = "/tegra-capture-vi/ports/port@6/endpoint";
		__overlay__ {
			status = "okay";
			vc-id = <2>;
			port-index = <2>;
			bus-width = <4>;
		};
	};
	fragment@15 {
		target-path = "/tegra-capture-vi/ports/port@7";
		__overlay__ {
			status = "okay";
		};
	};
	fragment@16 {
		target-path = "/tegra-capture-vi/ports/port@7/endpoint";
		__overlay__ {
			status = "okay";
			vc-id = <3>;
			port-index = <2>;
			bus-width = <4>;
		};
	};
	fragment@17 {
		target-path = "/tegra-capture-vi/ports/port@8";
		__overlay__ {
			status = "okay";
		};
	};
	fragment@18 {
		target-path = "/tegra-capture-vi/ports/port@8/endpoint";
		__overlay__ {
			status = "okay";
		};
	};
	fragment@19 {
		target-path = "/tegra-capture-vi/ports/port@9";
		__overlay__ {
			status = "okay";
		};
	};
	fragment@20 {
		target-path = "/tegra-capture-vi/ports/port@9/endpoint";
		__overlay__ {
			status = "okay";
		};
	};
	fragment@21 {
		target-path = "/tegra-capture-vi/ports/port@10";
		__overlay__ {
			status = "okay";
		};
	};
	fragment@22 {
		target-path = "/tegra-capture-vi/ports/port@10/endpoint";
		__overlay__ {
			status = "okay";
		};
	};
	fragment@23 {
		target-path = "/tegra-capture-vi/ports/port@11";
		__overlay__ {
			status = "okay";
		};
	};
	fragment@24 {
		target-path = "/tegra-capture-vi/ports/port@11/endpoint";
		__overlay__ {
			status = "okay";
		};
	};
	fragment@25 {
		target-path = "/tegra-capture-vi/ports/port@12";
		__overlay__ {
			status = "okay";
		};
	};
	fragment@26 {
		target-path = "/tegra-capture-vi/ports/port@12/endpoint";
		__overlay__ {
			status = "okay";
		};
	};
	fragment@27 {
		target-path = "/tegra-capture-vi/ports/port@13";
		__overlay__ {
			status = "okay";
		};
	};
	fragment@28 {
		target-path = "/tegra-capture-vi/ports/port@13/endpoint";
		__overlay__ {
			status = "okay";
		};
	};
	fragment@29 {
		target-path = "/tegra-capture-vi/ports/port@14";
		__overlay__ {
			status = "okay";
		};
	};
	fragment@30 {
		target-path = "/tegra-capture-vi/ports/port@14/endpoint";
		__overlay__ {
			status = "okay";
		};
	};
	fragment@31 {
		target-path = "/tegra-capture-vi/ports/port@15";
		__overlay__ {
			status = "okay";
		};
	};
	fragment@32 {
		target-path = "/tegra-capture-vi/ports/port@15/endpoint";
		__overlay__ {
			status = "okay";
		};
	};

	/* Enable CSI ports */
	fragment@33 {
		target-path = "/host1x@13e00000/nvcsi@15a00000";
		__overlay__ {
			num-channels = <16>;
		};
	};
	fragment@34 {
		target-path = "/host1x@13e00000/nvcsi@15a00000/channel@0";
		__overlay__ {
			status = "okay";
		};
	};
	fragment@35 {
		target-path = "/host1x@13e00000/nvcsi@15a00000/channel@0/ports/port@0";
		__overlay__ {
			status = "okay";
		};
	};
	fragment@36 {
		target-path = "/host1x@13e00000/nvcsi@15a00000/channel@0/ports/port@0/endpoint@0";
		__overlay__ {
			status = "okay";
		};
	};
	fragment@37 {
		target-path = "/host1x@13e00000/nvcsi@15a00000/channel@0/ports/port@1";
		__overlay__ {
			status = "okay";
		};
	};
	fragment@38 {
		target-path = "/host1x@13e00000/nvcsi@15a00000/channel@0/ports/port@1/endpoint@1";
		__overlay__ {
			status = "okay";
		};
	};
	fragment@39 {
		target-path = "/host1x@13e00000/nvcsi@15a00000/channel@1";
		__overlay__ {
			status = "okay";
		};
	};
	fragment@40 {
		target-path = "/host1x@13e00000/nvcsi@15a00000/channel@1/ports/port@0";
		__overlay__ {
			status = "okay";
		};
	};
	fragment@41 {
		target-path = "/host1x@13e00000/nvcsi@15a00000/channel@1/ports/port@0/endpoint@2";
		__overlay__ {
			status = "okay";
		};
	};
	fragment@42 {
		target-path = "/host1x@13e00000/nvcsi@15a00000/channel@1/ports/port@1";
		__overlay__ {
			status = "okay";
		};
	};
	fragment@43 {
		target-path = "/host1x@13e00000/nvcsi@15a00000/channel@1/ports/port@1/endpoint@3";
		__overlay__ {
			status = "okay";
		};
	};
	fragment@44 {
		target-path = "/host1x@13e00000/nvcsi@15a00000/channel@2";
		__overlay__ {
			status = "okay";
		};
	};
	fragment@45 {
		target-path = "/host1x@13e00000/nvcsi@15a00000/channel@2/ports/port@0";
		__overlay__ {
			status = "okay";
		};
	};
	fragment@46 {
		target-path = "/host1x@13e00000/nvcsi@15a00000/channel@2/ports/port@0/endpoint@4";
		__overlay__ {
			status = "okay";
		};
	};
	fragment@47 {
		target-path = "/host1x@13e00000/nvcsi@15a00000/channel@2/ports/port@1";
		__overlay__ {
			status = "okay";
		};
	};
	fragment@48 {
		target-path = "/host1x@13e00000/nvcsi@15a00000/channel@2/ports/port@1/endpoint@5";
		__overlay__ {
			status = "okay";
		};
	};
	fragment@49 {
		target-path = "/host1x@13e00000/nvcsi@15a00000/channel@3";
		__overlay__ {
			status = "okay";
		};
	};
	fragment@50 {
		target-path = "/host1x@13e00000/nvcsi@15a00000/channel@3/ports/port@0";
		__overlay__ {
			status = "okay";
		};
	};
	fragment@51 {
		target-path = "/host1x@13e00000/nvcsi@15a00000/channel@3/ports/port@0/endpoint@6";
		__overlay__ {
			status = "okay";
		};
	};
	fragment@52 {
		target-path = "/host1x@13e00000/nvcsi@15a00000/channel@3/ports/port@1";
		__overlay__ {
			status = "okay";
		};
	};
	fragment@53 {
		target-path = "/host1x@13e00000/nvcsi@15a00000/channel@3/ports/port@1/endpoint@7";
		__overlay__ {
			status = "okay";
		};
	};
	fragment@54 {
		target-path = "/host1x@13e00000/nvcsi@15a00000/channel@4";
		__overlay__ {
			status = "okay";
		};
	};
	fragment@55 {
		target-path = "/host1x@13e00000/nvcsi@15a00000/channel@4/ports/port@0";
		__overlay__ {
			status = "okay";
		};
	};
	fragment@56 {
		target-path = "/host1x@13e00000/nvcsi@15a00000/channel@4/ports/port@0/endpoint@8";
		__overlay__ {
			status = "okay";
		};
	};
	fragment@57 {
		target-path = "/host1x@13e00000/nvcsi@15a00000/channel@4/ports/port@1";
		__overlay__ {
			status = "okay";
		};
	};
	fragment@58 {
		target-path = "/host1x@13e00000/nvcsi@15a00000/channel@4/ports/port@1/endpoint@9";
		__overlay__ {
			status = "okay";
		};
	};
	fragment@59 {
		target-path = "/host1x@13e00000/nvcsi@15a00000/channel@5";
		__overlay__ {
			status = "okay";
		};
	};
	fragment@60 {
		target-path = "/host1x@13e00000/nvcsi@15a00000/channel@5/ports/port@0";
		__overlay__ {
			status = "okay";
		};
	};
	fragment@61 {
		target-path = "/host1x@13e00000/nvcsi@15a00000/channel@5/ports/port@0/endpoint@10";
		__overlay__ {
			status = "okay";
		};
	};
	fragment@62 {
		target-path = "/host1x@13e00000/nvcsi@15a00000/channel@5/ports/port@1";
		__overlay__ {
			status = "okay";
		};
	};
	fragment@63 {
		target-path = "/host1x@13e00000/nvcsi@15a00000/channel@5/ports/port@1/endpoint@11";
		__overlay__ {
			status = "okay";
		};
	};
	fragment@64 {
		target-path = "/host1x@13e00000/nvcsi@15a00000/channel@6";
		__overlay__ {
			status = "okay";
		};
	};
	fragment@65 {
		target-path = "/host1x@13e00000/nvcsi@15a00000/channel@6/ports/port@0";
		__overlay__ {
			status = "okay";
		};
	};
	fragment@66 {
		target-path = "/host1x@13e00000/nvcsi@15a00000/channel@6/ports/port@0/endpoint@12";
		__overlay__ {
			status = "okay";
		};
	};
	fragment@67 {
		target-path = "/host1x@13e00000/nvcsi@15a00000/channel@6/ports/port@1";
		__overlay__ {
			status = "okay";
		};
	};
	fragment@68 {
		target-path = "/host1x@13e00000/nvcsi@15a00000/channel@6/ports/port@1/endpoint@13";
		__overlay__ {
			status = "okay";
		};
	};
	fragment@69 {
		target-path = "/host1x@13e00000/nvcsi@15a00000/channel@7";
		__overlay__ {
			status = "okay";
		};
	};
	fragment@70 {
		target-path = "/host1x@13e00000/nvcsi@15a00000/channel@7/ports/port@0";
		__overlay__ {
			status = "okay";
		};
	};
	fragment@71 {
		target-path = "/host1x@13e00000/nvcsi@15a00000/channel@7/ports/port@0/endpoint@14";
		__overlay__ {
			status = "okay";
		};
	};
	fragment@72 {
		target-path = "/host1x@13e00000/nvcsi@15a00000/channel@7/ports/port@1";
		__overlay__ {
			status = "okay";
		};
	};
	fragment@73 {
		target-path = "/host1x@13e00000/nvcsi@15a00000/channel@7/ports/port@1/endpoint@15";
		__overlay__ {
			status = "okay";
		};
	};
	fragment@74 {
		target-path = "/host1x@13e00000/nvcsi@15a00000/channel@8";
		__overlay__ {
			status = "okay";
		};
	};
	fragment@75 {
		target-path = "/host1x@13e00000/nvcsi@15a00000/channel@8/ports/port@0";
		__overlay__ {
			status = "okay";
		};
	};
	fragment@76 {
		target-path = "/host1x@13e00000/nvcsi@15a00000/channel@8/ports/port@0/endpoint@16";
		__overlay__ {
			status = "okay";
		};
	};
	fragment@77 {
		target-path = "/host1x@13e00000/nvcsi@15a00000/channel@8/ports/port@1";
		__overlay__ {
			status = "okay";
		};
	};
	fragment@78 {
		target-path = "/host1x@13e00000/nvcsi@15a00000/channel@8/ports/port@1/endpoint@17";
		__overlay__ {
			status = "okay";
		};
	};
	fragment@79 {
		target-path = "/host1x@13e00000/nvcsi@15a00000/channel@9";
		__overlay__ {
			status = "okay";
		};
	};
	fragment@80 {
		target-path = "/host1x@13e00000/nvcsi@15a00000/channel@9/ports/port@0";
		__overlay__ {
			status = "okay";
		};
	};
	fragment@81 {
		target-path = "/host1x@13e00000/nvcsi@15a00000/channel@9/ports/port@0/endpoint@18";
		__overlay__ {
			status = "okay";
		};
	};
	fragment@82 {
		target-path = "/host1x@13e00000/nvcsi@15a00000/channel@9/ports/port@1";
		__overlay__ {
			status = "okay";
		};
	};
	fragment@83 {
		target-path = "/host1x@13e00000/nvcsi@15a00000/channel@9/ports/port@1/endpoint@19";
		__overlay__ {
			status = "okay";
		};
	};
	fragment@84 {
		target-path = "/host1x@13e00000/nvcsi@15a00000/channel@10";
		__overlay__ {
			status = "okay";
		};
	};
	fragment@85 {
		target-path = "/host1x@13e00000/nvcsi@15a00000/channel@10/ports/port@0";
		__overlay__ {
			status = "okay";
		};
	};
	fragment@86 {
		target-path = "/host1x@13e00000/nvcsi@15a00000/channel@10/ports/port@0/endpoint@20";
		__overlay__ {
			status = "okay";
		};
	};
	fragment@87 {
		target-path = "/host1x@13e00000/nvcsi@15a00000/channel@10/ports/port@1";
		__overlay__ {
			status = "okay";
		};
	};
	fragment@88 {
		target-path = "/host1x@13e00000/nvcsi@15a00000/channel@10/ports/port@1/endpoint@21";
		__overlay__ {
			status = "okay";
		};
	};
	fragment@89 {
		target-path = "/host1x@13e00000/nvcsi@15a00000/channel@11";
		__overlay__ {
			status = "okay";
		};
	};
	fragment@90 {
		target-path = "/host1x@13e00000/nvcsi@15a00000/channel@11/ports/port@0";
		__overlay__ {
			status = "okay";
		};
	};
	fragment@91 {
		target-path = "/host1x@13e00000/nvcsi@15a00000/channel@11/ports/port@0/endpoint@22";
		__overlay__ {
			status = "okay";
		};
	};
	fragment@92 {
		target-path = "/host1x@13e00000/nvcsi@15a00000/channel@11/ports/port@1";
		__overlay__ {
			status = "okay";
		};
	};
	fragment@93 {
		target-path = "/host1x@13e00000/nvcsi@15a00000/channel@11/ports/port@1/endpoint@23";
		__overlay__ {
			status = "okay";
		};
	};
	fragment@94 {
		target-path = "/host1x@13e00000/nvcsi@15a00000/channel@12";
		__overlay__ {
			status = "okay";
		};
	};
	fragment@95 {
		target-path = "/host1x@13e00000/nvcsi@15a00000/channel@12/ports/port@0";
		__overlay__ {
			status = "okay";
		};
	};
	fragment@96 {
		target-path = "/host1x@13e00000/nvcsi@15a00000/channel@12/ports/port@0/endpoint@24";
		__overlay__ {
			status = "okay";
		};
	};
	fragment@97 {
		target-path = "/host1x@13e00000/nvcsi@15a00000/channel@12/ports/port@1";
		__overlay__ {
			status = "okay";
		};
	};
	fragment@98 {
		target-path = "/host1x@13e00000/nvcsi@15a00000/channel@12/ports/port@1/endpoint@25";
		__overlay__ {
			status = "okay";
		};
	};
	fragment@99 {
		target-path = "/host1x@13e00000/nvcsi@15a00000/channel@13";
		__overlay__ {
			status = "okay";
		};
	};
	fragment@100 {
		target-path = "/host1x@13e00000/nvcsi@15a00000/channel@13/ports/port@0";
		__overlay__ {
			status = "okay";
		};
	};
	fragment@101 {
		target-path = "/host1x@13e00000/nvcsi@15a00000/channel@13/ports/port@0/endpoint@26";
		__overlay__ {
			status = "okay";
		};
	};
	fragment@102 {
		target-path = "/host1x@13e00000/nvcsi@15a00000/channel@13/ports/port@1";
		__overlay__ {
			status = "okay";
		};
	};
	fragment@103 {
		target-path = "/host1x@13e00000/nvcsi@15a00000/channel@13/ports/port@1/endpoint@27";
		__overlay__ {
			status = "okay";
		};
	};
	fragment@104 {
		target-path = "/host1x@13e00000/nvcsi@15a00000/channel@14";
		__overlay__ {
			status = "okay";
		};
	};
	fragment@105 {
		target-path = "/host1x@13e00000/nvcsi@15a00000/channel@14/ports/port@0";
		__overlay__ {
			status = "okay";
		};
	};
	fragment@106 {
		target-path = "/host1x@13e00000/nvcsi@15a00000/channel@14/ports/port@0/endpoint@28";
		__overlay__ {
			status = "okay";
		};
	};
	fragment@107 {
		target-path = "/host1x@13e00000/nvcsi@15a00000/channel@14/ports/port@1";
		__overlay__ {
			status = "okay";
		};
	};
	fragment@108 {
		target-path = "/host1x@13e00000/nvcsi@15a00000/channel@14/ports/port@1/endpoint@29";
		__overlay__ {
			status = "okay";
		};
	};
	fragment@109 {
		target-path = "/host1x@13e00000/nvcsi@15a00000/channel@15";
		__overlay__ {
			status = "okay";
		};
	};
	fragment@110 {
		target-path = "/host1x@13e00000/nvcsi@15a00000/channel@15/ports/port@0";
		__overlay__ {
			status = "okay";
		};
	};
	fragment@111 {
		target-path = "/host1x@13e00000/nvcsi@15a00000/channel@15/ports/port@0/endpoint@30";
		__overlay__ {
			status = "okay";
		};
	};
	fragment@112 {
		target-path = "/host1x@13e00000/nvcsi@15a00000/channel@15/ports/port@1";
		__overlay__ {
			status = "okay";
		};
	};
	fragment@113 {
		target-path = "/host1x@13e00000/nvcsi@15a00000/channel@15/ports/port@1/endpoint@31";
		__overlay__ {
			status = "okay";
		};
	};

	/* tegra-camera-platform settings */
	fragment@114 {
		target-path = "/tegra-camera-platform";
		__overlay__ {
			num_csi_lanes = <4>;
			max_lane_speed = <4000000>;
		};
	};
	fragment@115 {
		target-path = "/tegra-camera-platform/modules/module0";
		__overlay__ {
			status = "okay";
		};
	};
	fragment@116 {
		target-path = "/tegra-camera-platform/modules/module0/drivernode0";
		__overlay__ {
			status = "okay";
		};
	};
	fragment@117 {
		target-path = "/tegra-camera-platform/modules/module1";
		__overlay__ {
			status = "okay";
		};
	};
	fragment@118 {
		target-path = "/tegra-camera-platform/modules/module1/drivernode0";
		__overlay__ {
			status = "okay";
		};
	};
	fragment@119 {
		target-path = "/tegra-camera-platform/modules/module2";
		__overlay__ {
			status = "okay";
		};
	};
	fragment@120 {
		target-path = "/tegra-camera-platform/modules/module2/drivernode0";
		__overlay__ {
			status = "okay";
		};
	};
	fragment@121 {
		target-path = "/tegra-camera-platform/modules/module3";
		__overlay__ {
			status = "okay";
		};
	};
	fragment@122 {
		target-path = "/tegra-camera-platform/modules/module3/drivernode0";
		__overlay__ {
			status = "okay";
		};
	};
	fragment@123 {
		target-path = "/tegra-camera-platform/modules/module4";
		__overlay__ {
			status = "okay";
		};
	};
	fragment@124 {
		target-path = "/tegra-camera-platform/modules/module4/drivernode0";
		__overlay__ {
			status = "okay";
		};
	};
	fragment@125 {
		target-path = "/tegra-camera-platform/modules/module5";
		__overlay__ {
			status = "okay";
		};
	};
	fragment@126 {
		target-path = "/tegra-camera-platform/modules/module5/drivernode0";
		__overlay__ {
			status = "okay";
		};
	};
	fragment@127 {
		target-path = "/tegra-camera-platform/modules/module6";
		__overlay__ {
			status = "okay";
		};
	};
	fragment@128 {
		target-path = "/tegra-camera-platform/modules/module6/drivernode0";
		__overlay__ {
			status = "okay";
		};
	};
	fragment@129 {
		target-path = "/tegra-camera-platform/modules/module7";
		__overlay__ {
			status = "okay";
		};
	};
	fragment@130 {
		target-path = "/tegra-camera-platform/modules/module7/drivernode0";
		__overlay__ {
			status = "okay";
		};
	};
	fragment@131 {
		target-path = "/tegra-camera-platform/modules/module8";
		__overlay__ {
			status = "okay";
		};
	};
	fragment@132 {
		target-path = "/tegra-camera-platform/modules/module8/drivernode0";
		__overlay__ {
			status = "okay";
		};
	};
	fragment@133 {
		target-path = "/tegra-camera-platform/modules/module9";
		__overlay__ {
			status = "okay";
		};
	};
	fragment@134 {
		target-path = "/tegra-camera-platform/modules/module9/drivernode0";
		__overlay__ {
			status = "okay";
		};
	};
	fragment@135 {
		target-path = "/tegra-camera-platform/modules/module10";
		__overlay__ {
			status = "okay";
		};
	};
	fragment@136 {
		target-path = "/tegra-camera-platform/modules/module10/drivernode0";
		__overlay__ {
			status = "okay";
		};
	};
	fragment@137 {
		target-path = "/tegra-camera-platform/modules/module11";
		__overlay__ {
			status = "okay";
		};
	};
	fragment@138 {
		target-path = "/tegra-camera-platform/modules/module11/drivernode0";
		__overlay__ {
			status = "okay";
		};
	};
	fragment@139 {
		target-path = "/tegra-camera-platform/modules/module12";
		__overlay__ {
			status = "okay";
		};
	};
	fragment@140 {
		target-path = "/tegra-camera-platform/modules/module12/drivernode0";
		__overlay__ {
			status = "okay";
		};
	};
	fragment@141 {
		target-path = "/tegra-camera-platform/modules/module13";
		__overlay__ {
			status = "okay";
		};
	};
	fragment@142 {
		target-path = "/tegra-camera-platform/modules/module13/drivernode0";
		__overlay__ {
			status = "okay";
		};
	};
	fragment@143 {
		target-path = "/tegra-camera-platform/modules/module14";
		__overlay__ {
			status = "okay";
		};
	};
	fragment@144 {
		target-path = "/tegra-camera-platform/modules/module14/drivernode0";
		__overlay__ {
			status = "okay";
		};
	};
	fragment@145 {
		target-path = "/tegra-camera-platform/modules/module15";
		__overlay__ {
			status = "okay";
		};
	};
	fragment@146 {
		target-path = "/tegra-camera-platform/modules/module15/drivernode0";
		__overlay__ {
			status = "okay";
		};
	};

	/* pca9546 i2c mux */
	fragment@147 {
		target-path = "/i2c@3180000/tca9546@70";
		__overlay__ {
			status = "okay";
		};
	};

	fragment@148 {
		target-path = "/i2c@3180000/tca9546@70/i2c@0/sensing_sensors_a@1b";
		__overlay__ {
			status = "okay";
		};
	};
	fragment@149 {
		target-path = "/i2c@3180000/tca9546@70/i2c@0/sensing_sensors_b@1c";
		__overlay__ {
			status = "okay";
		};
	};
	fragment@150 {
		target-path = "/i2c@3180000/tca9546@70/i2c@0/sensing_sensors_c@1d";
		__overlay__ {
			status = "okay";
		};
	};
	fragment@151 {
		target-path = "/i2c@3180000/tca9546@70/i2c@0/sensing_sensors_d@1e";
		__overlay__ {
			status = "okay";
		};
	};
	fragment@152 {
		target-path = "/i2c@3180000/tca9546@70/i2c@1/sensing_sensors_e@1b";
		__overlay__ {
			status = "okay";
		};
	};
	fragment@153 {
		target-path = "/i2c@3180000/tca9546@70/i2c@1/sensing_sensors_f@1c";
		__overlay__ {
			status = "okay";
		};
	};
	fragment@154 {
		target-path = "/i2c@3180000/tca9546@70/i2c@1/sensing_sensors_g@1d";
		__overlay__ {
			status = "okay";
		};
	};
	fragment@155 {
		target-path = "/i2c@3180000/tca9546@70/i2c@1/sensing_sensors_h@1e";
		__overlay__ {
			status = "okay";
		};
	};
	fragment@156 {
		target-path = "/i2c@3180000/tca9546@70/i2c@2/sensing_sensors_i@1b";
		__overlay__ {
			status = "okay";
		};
	};
	fragment@157 {
		target-path = "/i2c@3180000/tca9546@70/i2c@2/sensing_sensors_j@1c";
		__overlay__ {
			status = "okay";
		};
	};
	fragment@158 {
		target-path = "/i2c@3180000/tca9546@70/i2c@2/sensing_sensors_k@1d";
		__overlay__ {
			status = "okay";
		};
	};
	fragment@159 {
		target-path = "/i2c@3180000/tca9546@70/i2c@2/sensing_sensors_l@1e";
		__overlay__ {
			status = "okay";
		};
	};
	fragment@160 {
		target-path = "/i2c@3180000/tca9546@70/i2c@3/sensing_sensors_m@1b";
		__overlay__ {
			status = "okay";
		};
	};
	fragment@161 {
		target-path = "/i2c@3180000/tca9546@70/i2c@3/sensing_sensors_n@1c";
		__overlay__ {
			status = "okay";
		};
	};
	fragment@162 {
		target-path = "/i2c@3180000/tca9546@70/i2c@3/sensing_sensors_o@1d";
		__overlay__ {
			status = "okay";
		};
	};
	fragment@163 {
		target-path = "/i2c@3180000/tca9546@70/i2c@3/sensing_sensors_p@1e";
		__overlay__ {
			status = "okay";
		};
	};
};

